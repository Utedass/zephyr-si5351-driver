## drivers/clock_control/Kconfig.si5351
```kconfig
# Copyright (c) 2025 Jonatan Gezelius
# SPDX-License-Identifier: MIT

config CLOCK_CONTROL_SI5351
	bool "si5351 clock control driver"
	default y
	depends on DT_HAS_SKYWORKS_SI5351_ENABLED
	select I2C
	help
	  This option enables the clock driver for Skyworks si5351 programmable clock generator.

config CLOCK_CONTROL_SI5351_INIT_PRIORITY
	int "Init priority for SI5351 clock driver"
	default 60
	depends on CLOCK_CONTROL_SI5351
	help
	  Initialization priority for the SI5351 driver.
	  Must be higher than I2C init priority (usually 50)

config CLOCK_CONTROL_SI5351_DOUBLE_PRECISION
	bool "Use double instead of float for calculations"
	default n
	depends on CLOCK_CONTROL_SI5351
	help
	  This option makes for less errors when calculating the ratios, especially for high frequencies, but might impose a big speed penalty depending on underlaying hardware.

config CLOCK_CONTROL_SI5351_OVERRIDE_VCO_MIN_FREQUENCY
	bool "Override the datasheet specified minimum frequency"
	default n
	depends on CLOCK_CONTROL_SI5351
	help
	  The driver will use the lower limit specified in CLOCK_CONTROL_SI5351_VCO_MIN_FREQUENCY instead of the default specified for the part

config CLOCK_CONTROL_SI5351_VCO_MIN_FREQUENCY
	int "Frequency to use as VCO MIN in MHz"
	default 600
	depends on CLOCK_CONTROL_SI5351_OVERRIDE_VCO_MIN_FREQUENCY
	help
	  The lower limit the driver will allow the VCO frequency to be set to

config CLOCK_CONTROL_SI5351_OVERRIDE_VCO_MAX_FREQUENCY
	bool "Override the datasheet specified maximum frequency"
	default n
	depends on CLOCK_CONTROL_SI5351
	help
	  The driver will use the upper limit specified in CLOCK_CONTROL_SI5351_VCO_MAX_FREQUENCY instead of the default specified for the part

config CLOCK_CONTROL_SI5351_VCO_MAX_FREQUENCY
	int "Frequency to use as VCO MAX in MHz"
	default 900
	depends on CLOCK_CONTROL_SI5351_OVERRIDE_VCO_MAX_FREQUENCY
	help
	  The upper limit the driver will allow the VCO frequency to be set to
```

## dts/bindings/clock/skyworks,si5351-output.yaml
```yaml
description: Skyworks Si5351 individual clock output

compatible: "skyworks,si5351-output"

include: [base.yaml, clock-controller.yaml]

properties:
  reg:
    required: true
    description: Clock output number (0-2 for Si5351A)
  
  "#clock-cells":
    const: 0

  output-enabled:
    type: boolean
    description: Whether this clock output is enabled up at init

  powered-up:
    type: boolean
    description: Whether this clock circuitry is powered up at init

  integer-mode:
    type: boolean
    description: Enables integer mode if true

  clock-source:
    type: string
    enum: ["XTAL", "CLKIN", "multisynth"]
    default: "multisynth"
    description: Source for the clock output

  multisynth-source:
    type: string
    enum: ["PLLA", "PLLB"]
    default: "PLLA"
    description: PLL source for multisynth (PLLB is VCXO for Si5351B devices)

  drive-strength:
    type: int
    enum: [2, 4, 6, 8]
    default: 8
    description: Drive strength in mA

  invert:
    type: boolean
    description: Invert output clock polarity

  fixed-divider:
    type: boolean
    description: If true, the output divider is fixed and the driver won't change it, otherwise it is calculated based on the desired frequency
  
  frequency:
    type: int
    description: Desired output frequency in Hz
  
  frequency-fractional:
    type: int
    description: Desired output frequency fractional part of Hz, desired frequency = <frequency>.<frequency-fractional>
  
  a:
    type: int
    description: Multisynth A in divider = A + B / C
  
  b:
    type: int
    description: Multisynth B in divider = A + B / C
  
  c:
    type: int
    description: Multisynth C in divider = A + B / C

  p1:
    type: int
    description: Multisynth P1 parameter

  p2:
    type: int
    description: Multisynth P2 parameter

  p3:
    type: int
    description: Multisynth P3 parameter

  r:
    type: int
    enum: [1, 2, 4, 8, 16, 32, 64, 128]
    description: R0 output divider

  divide-by-four:
    type: boolean
    description: Enable the divide by four mode

  phase-offset:
    type: int
    description: Phase offset in number of 1/4 periods from whichever VCO/PLL associated with this output
  
  phase-offset-ps:
    type: int
    description: Phase offset in pico seconds
```

## dts/bindings/clock/skyworks,si5351.yaml
```yaml
description: Skyworks programmable clock generator

compatible: "skyworks,si5351"

include: [base.yaml, i2c-device.yaml]


properties:
  model:
    type: string
    enum:
      - si5351a-b-gt
      - si5351a-b-gm1
      - si5351a-b-gm
      - si5351b-b-gm1
      - si5351b-b-gm
      - si5351c-b-gm1
      - si5351c-b-gm
    required: true
    description: "Allowed values are: si5351a-b-gt, si5351a-b-gm1, si5351a-b-gm, si5351b-b-gm1, si5351b-b-gm, si5351c-b-gm1, si5351c-b-gm"

  xtal-frequency:
    type: int
    enum: [25, 27]
    default: 25
    required: true
    description: Crystal frequency in MHz

  xtal-load:
    type: int
    enum: [6, 8, 10]
    default: 10
    description: Selects load capacitance for crystal

  clkin-frequency:
    type: int
    description: CLKIN input clock frequency in Hz

  clkin-div:
    type: int
    enum: [1, 2, 4, 8]
    default: 1
    description: CLKIN input clock divider

  plla-clock-source:
    type: string
    enum: ["XTAL", "CLKIN"]
    default: "XTAL"
    description: Clock input to PLLA

  plla-fixed-multiplier:
    type: boolean
    description: If true, PLLA multiplier is fixed and the driver won't change it, otherwise it is calculated based on the desired frequency

  plla-frequency:
    type: int
    description: Desired PLLA fvco frequency in Hz

  plla-frequency-fractional:
    type: int
    description: Desired PLLA fvco frequency fractional part of Hz, desired frequency = <frequency>.<frequency-fractional>

  plla-integer-mode:
    type: boolean
    description: Enables integer mode for PLLA if true

  plla-a:
    type: int
    description: PLLA A in multiplier = A + B / C

  plla-b:
    type: int
    description: PLLA B in multiplier = A + B / C
  
  plla-c:
    type: int
    description: PLLA C in multiplier = A + B / C
  
  plla-p1:
    type: int
    description: PLLA P1 parameter

  plla-p2:
    type: int
    description: PLLA P2 parameter

  plla-p3:
    type: int
    description: PLLA P3 parameter

  pllb-clock-source:
    type: string
    enum: ["XTAL", "CLKin"]
    default: "XTAL"
    description: Clock input to PLLB

  pllb-fixed-multiplier:
    type: boolean
    description: If true, PLLB multiplier is fixed and the driver won't change it, otherwise it is calculated based on the desired frequency

  pllb-frequency:
    type: int
    description: Desired PLLB fvco frequency in Hz

  pllb-frequency-fractional:
    type: int
    description: Desired PLLB fvco frequency fractional part of Hz, desired frequency = <frequency>.<frequency-fractional>

  pllb-integer-mode:
    type: boolean
    description: Enables integer mode for PLLB if true

  pllb-a:
    type: int
    description: PLLB A in multiplier = A + B / C

  pllb-b:
    type: int
    description: PLLB B in multiplier = A + B / C

  pllb-c:
    type: int
    description: PLLB C in multiplier = A + B / C
  
  pllb-p1:
    type: int
    default: 3328
    description: PLLB P1 parameter

  pllb-p2:
    type: int
    default: 0
    description: PLLB P2 parameter

  pllb-p3:
    type: int
    default: 1
    description: PLLB P3 parameter
```
